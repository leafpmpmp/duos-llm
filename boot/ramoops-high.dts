// SPDX-License-Identifier: MIT
// Move ramoops from 0x90000000 to 0x9e000000.
// The CMA pool can then use one block from the initrd up to 0x9e000000.
/dts-v1/;
/plugin/;

/ {
	fragment@0 {
		target-path = "/reserved-memory";
		__overlay__ {
			#address-cells = <1>;
			#size-cells = <1>;

			ramoops@90000000 {
				reg = <0x90000000 0x100000>;
				status = "disabled";
			};
			ramoops@9e000000 {
				compatible = "ramoops";
				reg = <0x9e000000 0x100000>;
				record-size = <0x8000>;
				console-size = <0x20000>;
			};
		};
	};
};
